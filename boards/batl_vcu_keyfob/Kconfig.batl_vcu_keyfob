## boards/batl_vcu_keyfob/Kconfig.batl_vcu_keyfob
```kconfig
# Kconfig.batl_vcu_keyfob — Board Identity in the Kconfig Tree
#
# =============================================================================
# WHAT THIS FILE DOES
# =============================================================================
#
# This file registers your board in Zephyr's Kconfig system. When you pass
# "-b batl_vcu_keyfob" to west build, the build system defines the symbol
# BOARD_BATL_VCU_KEYFOB automatically. This file then uses 'select' to pull
# in the correct SoC configuration.
#
# The 'select' statement is a Kconfig mechanism that forces another symbol
# to be enabled. So 'select SOC_EFR32BG24A010F1024IM48' means: "when this
# board is chosen, automatically enable the SoC configuration for the
# EFR32BG24A010F1024IM48."
#
# IMPORTANT: The SOC symbol name must match what's defined in the Zephyr
# SoC Kconfig tree under zephyr/soc/silabs/. If the exact part number
# isn't defined as a Kconfig symbol, you may need to use a broader family
# symbol like SOC_EFR32BG24 or SOC_SERIES_EFR32BG24.
#
# To find available SoC Kconfig symbols, search:
#   grep -r "SOC_EFR32BG24\|SOC_SERIES_EFR32BG24" <workspace>/zephyr/soc/silabs/
# =============================================================================

config BOARD_BATL_VCU_KEYFOB
	select SOC_EFR32BG24A010F1024IM48
```

## boards/batl_vcu_keyfob/Kconfig.defconfig
```kconfig
# Kconfig.defconfig — Override Defaults for Existing Kconfig Symbols
#
# =============================================================================
# WHAT THIS FILE DOES
# =============================================================================
#
# This file is different from the _defconfig file. While _defconfig sets
# values in a .conf format (KEY=VALUE), this file uses Kconfig syntax
# to override DEFAULT values of existing symbols.
#
# Use this when you need to change the default of a symbol that's defined
# somewhere else in the Zephyr tree. Common uses:
#   - Setting default stack sizes
#   - Changing default peripheral configurations
#   - Adjusting buffer sizes for your hardware constraints
#
# The 'if BOARD_BATL_VCU_KEYFOB' guard ensures these overrides only apply
# when building for your board.
# =============================================================================

if BOARD_BATL_VCU_KEYFOB

config MAIN_STACK_SIZE
	default 2304

config CMU_HFXO_FREQ
	default 40000000

config CMU_LFXO_FREQ
	default 32768

# No additional default overrides needed at this point.
# When you add UART later, you might add something like:
#
# config SERIAL
#     default y
#
# config CONSOLE
#     default y
#
# config UART_CONSOLE
#     default y

endif # BOARD_BATL_VCU_KEYFOB
```

## boards/batl_vcu_keyfob/batl_vcu_keyfob_defconfig
```kconfig
# my_bg24_keyless_defconfig — Default Kconfig for Custom BG24 Board
#
# =============================================================================
# WHAT THIS FILE DOES
# =============================================================================
#
# This file sets default Kconfig values that are ALWAYS applied when someone
# builds for your board. Think of it as "the minimum software configuration
# that makes this board work."
#
# These settings are applied BEFORE your application's prj.conf, so your
# app can override them if needed.
#
# Convention: Only put hardware-related essentials here. Application-specific
# settings (like BLE advertising parameters) go in your app's prj.conf.
# =============================================================================

# ---- GPIO ----
# Your board has an LED on PB00, so GPIO must be enabled.
# Without this, the gpio-leds driver won't be compiled.
CONFIG_GPIO=y

# ---- Bluetooth ----
# Enable the Bluetooth stack core
CONFIG_BT=y
# # Use Silicon Labs' proprietary HCI driver (RAIL-based link layer).
# # This is the equivalent of CONFIG_BT_LL_SOFTDEVICE on Nordic — it tells
# # Zephyr which BLE controller implementation to use.
# CONFIG_BT_SILABS_EFR32=y

# ---- ARM Cortex-M33 Features ----
# Enable the Memory Protection Unit for stack overflow detection
# and memory isolation. Important for a security-critical system.
CONFIG_ARM_MPU=y
CONFIG_HW_STACK_PROTECTION=y

# ---- FPU ----
# The EFR32BG24 Cortex-M33 has a hardware FPU.
# The SiLabs BLE blobs (liblinklayer, libbgcommon, librail) are compiled
# with -mfloat-abi=hard (VFP register args), so the app must match.
CONFIG_FPU=y
CONFIG_FPU_SHARING=y

# # ---- Watchdog ----
# # Enable watchdog driver (we enabled wdog0 in DTS)
# CONFIG_WATCHDOG=y
```

## boards/batl_vcu_keyfob/board.yml
```yaml
# board.yml — Board Identity File
#
# This file tells Zephyr's build system WHO this board is.
# It's the first file Zephyr reads when you pass "-b BATL_VCU_KeyFob".
#
# The 'name' must match the directory name and the filenames of your
# .dts and _defconfig files. If they don't match, the build system
# won't find them.
#
# The 'socs' entry links this board to a SoC definition that already
# exists in zephyr/soc/silabs/. The SoC definition provides the CPU
# architecture, interrupt controller, memory map, and peripheral
# register addresses.
#
# IMPORTANT: If building fails with "SoC not found", you need to check
# what SoC identifiers exist in your workspace under zephyr/soc/silabs/.
# The BG24 and MG24 share the same die, so the SoC definition might be
# listed under a generic "efr32xg24" or "efr32mg24" name that also
# covers your BG24 part. In that case, use that SoC name here instead.
#
# To find available SoC names, run:
#   find <workspace>/zephyr/soc/silabs -name "*.yml" | xargs grep -l "bg24\|xg24\|mg24"

board:
  name: batl_vcu_keyfob
  vendor: BATL
  socs:
    - name: efr32bg24a010f1024im48
```
